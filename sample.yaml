## sample.yaml
```yaml
namespace: sample
sample:
  defines: runnable
  metadata:
    name: sample
    description: Sample Java Application
    icon: https://emojiapi.dev/api/v1/coffee.svg
  containers:
    sample:
      build: .
  services:
    http:
      container: sample
      port: 8080
      host-port: 8080
      publish: false
      protocol: TCP
      description: Default port Spring Boot applications run on
  variables:
    java-version:
      env: JAVA_VERSION
      type: string
      description: Java version used
      value: '1.8'
```
